/dts-v1/;

/*
 * GPIO 模拟 I2C 的完整板级 DTS 教学文件。
 * GPIO4_A0/A1 只是语法示例，不是对任何板卡的可用引脚推荐。
 * 上板前必须依据原理图更换为空闲引脚，并核对复用、电源和上拉。
 */
#include "rk3568.dtsi"

/ {
	model = "RK3568 GPIO-bit-banged I2C teaching board";
	compatible = "demo,rk3568-i2c-gpio-teaching", "rockchip,rk3568";

	i2c_gpio: i2c-gpio {
		compatible = "i2c-gpio";
		sda-gpios = <&gpio4 RK_PA0 GPIO_ACTIVE_HIGH>;
		scl-gpios = <&gpio4 RK_PA1 GPIO_ACTIVE_HIGH>;
		i2c-gpio,delay-us = <5>;  /* 默认 100 kHz 的半周期延时 */
		i2c-gpio,timeout-ms = <100>;
		#address-cells = <1>;
		#size-cells = <0>;
		status = "okay";

		eeprom@50 {
			compatible = "demo,at24c02-reader";
			reg = <0x50>;
		};
	};
};

/* 两种控制器实验互斥，避免把同一颗教学外设误当成两条总线上的设备。 */
&i2c1 {
	status = "disabled";
};
